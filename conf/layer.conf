## conf/layer.conf
```bitbake
# We have a conf and classes directory, append to BBPATH
BBPATH .= ":${LAYERDIR}"

# We have a recipes directory, add to BBFILES
BBFILES += "${LAYERDIR}/recipes*/*/*.bb ${LAYERDIR}/recipes*/*/*.bbappend"

BBFILE_COLLECTIONS += "wr-vxworks7-openamp-demo-for-zcu102-layer"
BBFILE_PATTERN_wr-vxworks7-openamp-demo-for-zcu102-layer := "^${LAYERDIR}/"
BBFILE_PRIORITY_wr-vxworks7-openamp-demo-for-zcu102-layer = "5"

# Custom licenses used by some packages in this layer
LICENSE_PATH += "${LAYERDIR}/files/custom-licenses"

# This should only be incremented on significant changes that will
# cause compatibility issues with other layers
LAYERVERSION_wr-vxworks7-openamp-demo-for-zcu102-layer = "1"

LAYERSERIES_COMPAT_wr-vxworks7-openamp-demo-for-zcu102-layer = "rocko sumo thud"
```
